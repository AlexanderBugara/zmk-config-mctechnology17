/* PCA10059 Corne Dongle overlay */
#include <dt-bindings/zmk/matrix_transform.h>
#include <layouts/foostan/corne/6column.dtsi>

&foostan_corne_6col_layout {
    transform = <&default_transform>;
};

chosen {
    zephyr,console = &uart0;
};
