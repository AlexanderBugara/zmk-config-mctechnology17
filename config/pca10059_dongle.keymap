/ {
    keymap {
        compatible = "zmk,keymap";

        base_layer {
            bindings = <
                &kp A &kp B &kp C &kp D &kp E
                /* fill out the rest */
            >;
        };
    };
};
